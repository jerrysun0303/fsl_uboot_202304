## board/philips/mx6dl_venus/Kconfig
```kconfig
if TARGET_MX6DL_VENUS || TARGET_MX6DL_VENUS_COMMON

config SYS_BOARD
	default "mx6dl_venus"

config SYS_VENDOR
	default "philips"

config SYS_CONFIG_NAME
	default "mx6dl_venus"

config TEXT_BASE
    default 0x27800000
	
endif
```

## board/philips/mx6venus/Kconfig
```kconfig
if TARGET_MX6DL_VENUS

config SYS_BOARD
	default "mx6venus"

config SYS_VENDOR
	default "philips"

config SYS_CONFIG_NAME
	default "mx6dl_venus"

config TEXT_BASE
	default 0x27800000

endif
```

## configs/mx6dl_venus_defconfig
```kconfig
CONFIG_ARM=y
CONFIG_ARCH_MX6=y
CONFIG_SYS_MALLOC_LEN=0x1000000
CONFIG_NR_DRAM_BANKS=1
CONFIG_ENV_SIZE=0x2000
CONFIG_IMX_CONFIG="board/philips/mx6venus/mx6dl_venus.cfg"
CONFIG_MX6DL=y
CONFIG_TARGET_MX6DL_VENUS=y
CONFIG_DM_GPIO=y
CONFIG_DEFAULT_DEVICE_TREE="imx6dl-venus"
CONFIG_SYS_MONITOR_LEN=409600
CONFIG_SYS_LOAD_ADDR=0x10800000
CONFIG_FIT=y
CONFIG_BOOTDELAY=5
CONFIG_USE_BOOTCOMMAND=y
CONFIG_BOOTCOMMAND="mmc dev ${mmcdev};if mmc rescan; then if run loadbootscript; then run bootscript; else if run loadimage; then run mmcboot; else run netboot; fi; fi; else run netboot; fi"
CONFIG_SYS_DEVICE_NULLDEV=y
CONFIG_BMP=y
CONFIG_HUSH_PARSER=y
CONFIG_SYS_MAXARGS=32
CONFIG_SYS_PBSIZE=541
# CONFIG_CMD_RANDOM is not set
CONFIG_CMD_GPIO=y
CONFIG_CMD_I2C=y
CONFIG_CMD_MMC=y
CONFIG_CMD_BKOPS_ENABLE=y
CONFIG_CMD_MMC_SWRITE=y
# CONFIG_CMD_NAND is not set
CONFIG_CMD_PART=y
CONFIG_CMD_SDRAM=y
CONFIG_CMD_DHCP=y
CONFIG_CMD_MII=y
CONFIG_CMD_PING=y
CONFIG_CMD_CACHE=y
# CONFIG_CMD_CLS is not set
CONFIG_CMD_EXT4=y
CONFIG_CMD_EXT4_WRITE=y
CONFIG_CMD_FAT=y
CONFIG_CMD_FS_GENERIC=y
CONFIG_OF_CONTROL=y
CONFIG_ENV_OVERWRITE=y
CONFIG_SYS_RELOC_GD_ENV_ADDR=y
CONFIG_ENV_VARS_UBOOT_RUNTIME_CONFIG=y
CONFIG_USE_ETHPRIME=y
CONFIG_ETHPRIME="FEC0"
CONFIG_BOUNCE_BUFFER=y
# CONFIG_BLOCK_CACHE is not set
CONFIG_BUTTON=y
CONFIG_BUTTON_GPIO=y
CONFIG_DM_I2C=y
CONFIG_SYS_I2C_MXC=y
CONFIG_FSL_USDHC=y
CONFIG_MTD=y
CONFIG_MTD_RAW_NAND=y
CONFIG_NAND_MXS=y
CONFIG_SYS_NAND_ONFI_DETECTION=y
CONFIG_MTD_UBI=y
CONFIG_PHYLIB=y
CONFIG_PHY_SMSC=y
CONFIG_DM_ETH_PHY=y
CONFIG_FEC_MXC=y
CONFIG_MII=y
CONFIG_RMII=y
CONFIG_PINCTRL=y
CONFIG_PINCTRL_IMX6=y
CONFIG_DM_PMIC=y
CONFIG_DM_PMIC_TPS65910=y
CONFIG_DM_REGULATOR_TPS65910=y
CONFIG_DM_SERIAL=y
CONFIG_MXC_UART=y
CONFIG_SPI=y
CONFIG_DM_SPI=y
CONFIG_SPI_MEM=y
CONFIG_MXC_SPI=y
CONFIG_VIDEO=y
# CONFIG_VIDEO_FONT_8X16 is not set
# CONFIG_VIDEO_LOGO is not set
# CONFIG_BACKLIGHT is not set
# CONFIG_VIDEO_BPP8 is not set
# CONFIG_VIDEO_BPP16 is not set
# CONFIG_VIDEO_BPP32 is not set
# CONFIG_VIDEO_ANSI is not set
# CONFIG_CONSOLE_NORMAL is not set
# CONFIG_PANEL is not set
CONFIG_VIDEO_LOGO_MAX_SIZE=0x0
CONFIG_RSA=y
```
