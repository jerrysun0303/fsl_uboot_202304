// SPDX-License-Identifier: GPL-2.0
/*
 * Copyright (c) 2023 Koninklijke Philips N.V. All Rights Reserved.
 */

/dts-v1/;

#include "imx6dl.dtsi"
#include "imx6qdl-venus.dtsi"

/ {
	model = "i.MX6 DualLite Venus Smart Device Board";
	compatible = "fsl,imx6dl-sabresd", "fsl,imx6dl";
};
